## porton/sdkconfig.defaults
```kconfig
CONFIG_IDF_TARGET="esp32s3"
CONFIG_IDF_TARGET_ESP32S3=y

CONFIG_ESPTOOLPY_MONITOR_BAUD_OTHER_VAL=115200
CONFIG_ESPTOOLPY_FLASHMODE_QIO=y

CONFIG_PARTITION_TABLE_SINGLE_APP=y

CONFIG_ESP_TASK_WDT_PANIC=y

CONFIG_FREERTOS_HZ=1000

CONFIG_LWIP_LOCAL_HOSTNAME="porton-esp32s3"
```
